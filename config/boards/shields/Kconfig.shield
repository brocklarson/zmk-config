## config/boards/shields/Kconfig.shield
```kconfig
config SHIELD_SASUGA_LEFT
    def_bool $(shields_list_contains,sasuga_left)

config SHIELD_SASUGA_RIGHT
    def_bool $(shields_list_contains,sasuga_right)
```

## config/boards/shields/sasuga/Kconfig.shield
```kconfig
config SHIELD_sasuga_LEFT
    def_bool $(shields_list_contains,sasuga_left)

config SHIELD_sasuga_RIGHT
    def_bool $(shields_list_contains,sasuga_right)
```
